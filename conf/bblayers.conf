## conf/bblayers.conf
```bitbake
# POKY_BBLAYERS_CONF_VERSION is increased each time build/conf/bblayers.conf
# changes incompatibly
POKY_BBLAYERS_CONF_VERSION = "2"

BBPATH = "${TOPDIR}"
BBFILES ?= ""

YOCTOROOT = "${@os.path.abspath("${TOPDIR}")}"
BBLAYERS ?= " \
  ${YOCTOROOT}/poky/meta \
  ${YOCTOROOT}/poky/meta-poky \
  ${YOCTOROOT}/poky/meta-yocto-bsp \
  ${YOCTOROOT}/meta-sunxi \
  ${YOCTOROOT}/meta-arm/meta-arm \
  ${YOCTOROOT}/meta-arm/meta-arm-toolchain \
  ${YOCTOROOT}/meta-openembedded/meta-oe \
  ${YOCTOROOT}/meta-openembedded/meta-python \
  "
#  ${YOCTOROOT}/meta-orange/poky/meta 
#  ${YOCTOROOT}/meta-orange/poky/meta-poky 
#  ${YOCTOROOT}/meta-orange/poky/meta-yocto-bsp 
```

## conf/local.conf
```bitbake
LICENSE_FLAGS_ACCEPTED = " synaptics-killswitch \
                           commercial \
                           license \
                           "

MACHINE ??= "orange-pi-lite"
#MACHINE ??= "orange-pi-pc"
MACHINEOVERRIDES .= ":use-mailine-graphics"
#IMAGE_FSTYPES = "tar.xz ext3 rpi-sdimg"
IMAGE_FSTYPES += "wic.xz"
INIT_MANAGER = "systemd"
DISTRO_FEATURES:append = " systemd"
DISTRO_FEATURES_BACKFILL_CONSIDERED:append = " sysvinit"
VIRTUAL-RUNTIME_init_manager ??= "systemd"
VIRTUAL-RUNTIME_initscripts ??= "systemd-compat-units"
VIRTUAL-RUNTIME_login_manager ??= "shadow-base"
VIRTUAL-RUNTIME_dev_manager ??= "systemd"

DISTRO ?= "poky"

DISTRO_FEATURES:remove = " wayland vulkan x11 directfb "
DISTRO_FEATURES:append = " opengl gles2"

EXTRA_IMAGE_FEATURES ?= "debug-tweaks"

USER_CLASSES ?= "buildstats"

PATCHRESOLVE = "noop"

BB_DISKMON_DIRS ??= "\
    STOPTASKS,${TMPDIR},1G,100K \
    STOPTASKS,${DL_DIR},1G,100K \
    STOPTASKS,${SSTATE_DIR},1G,100K \
    STOPTASKS,/tmp,100M,100K \
    HALT,${TMPDIR},100M,1K \
    HALT,${DL_DIR},100M,1K \
    HALT,${SSTATE_DIR},100M,1K \
    HALT,/tmp,10M,1K"

PACKAGECONFIG:append:pn-qemu-system-native = " sdl"
CONF_VERSION = "2"
```
